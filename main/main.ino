#include <stdint.h>

typedef struct{
	uint8_t memory[1000];  
	uint8_t V[16];      /* All general purpose registers */
	uint16_t I;         /* Register to store memory addr */
	uint16_t pc;        /* Program counter */
	int display[32*8];  /* 256 bytes or 256*8 = 2048 bits*/
	uint8_t sp;         /* Stack pointer */
	uint16_t stack[16]; /* Stack */
}chip8;

chip8* c;
bool is_running = 0;
bool draw_flag = 0;

uint8_t chip8_fontset[80] = {
    0xF0, 0x90, 0x90, 0x90, 0xF0, // 0
    0x20, 0x60, 0x20, 0x20, 0x70, // 1
    0xF0, 0x10, 0xF0, 0x80, 0xF0, // 2
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    0xF0, 0x80, 0xF0, 0x80, 0x80  // F
};


const uint8_t ibm_ch8[] PROGMEM= {
  0x00, 0xe0, 0xa2, 0x2a, 0x60, 0x0c, 0x61, 0x08, 0xd0, 0x1f, 0x70, 0x09,
  0xa2, 0x39, 0xd0, 0x1f, 0xa2, 0x48, 0x70, 0x08, 0xd0, 0x1f, 0x70, 0x04,
  0xa2, 0x57, 0xd0, 0x1f, 0x70, 0x08, 0xa2, 0x66, 0xd0, 0x1f, 0x70, 0x08,
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  0x00, 0x80, 0x00, 0x80, 0x00, 0x80, 0x00, 0x80, 0x00, 0xe0, 0x00, 0xe0
};

void setup() {
  // put your setup code here, to run once:

  // serial code 
  Serial.begin(115200);
  while(!Serial);   /* Waits for serial port to connect */


  memset(c, 0, sizeof(*c));

  memcpy(c->memory[0], chip8_fontset, sizeof(chip8_fontset));  /* Loads fonts to sram */
  for(int i = 0; i < sizeof(ibm_ch8); i++){                    /* Loads game ROM to sram */
    c->memory[0x200 + i] = pgm_read_byte_near(ibm_ch8[i]);
  }

  c->pc = 0x200;    /* Start of game */
  bool is_running = 1;
}

void loop() {
  // put your main code here, to run repeatedly:

  if(!is_running)
    return;
  
  emulate_cycle();  
}

void emulate_cycle(){
  uint16_t opcode = (c->memory[c->pc] << 8) | c->memory[c->pc + 1];
  
  if (c->pc >= 1000)
    is_running = 0;

  c->pc += 2;
}
